/*
 * Copyright (c) 2023 The ZMK Contributors
 *
 * SPDX-License-Identifier: MIT
 */

// https://nickcoutsos.github.io/keymap-editor/

/*
 * Assign the cs-gpios pin to 4.
 * Uncomment these next few lines if implementing nice!view Displays
 */

nice_view_spi: &spi0 { cs-gpios = <&pro_micro 4 GPIO_ACTIVE_HIGH>; };

/*
 * Include the base keymap that contains all key bindings.
 * This ensures consistency between direct BT mode and dongle mode.
 */
#include "leeloo_base.keymap"
