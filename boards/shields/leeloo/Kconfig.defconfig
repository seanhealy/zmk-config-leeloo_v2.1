## boards/shields/leeloo/Kconfig.defconfig
```kconfig
# Copyright (c) 2024 The ZMK Contributors
# SPDX-License-Identifier: MIT

if SHIELD_LEELOO_DONGLE

config ZMK_KEYBOARD_NAME
    default "Leeloo"

config ZMK_SPLIT_ROLE_CENTRAL
    default y

config ZMK_SPLIT
    default y

# Leeloo has left and right halves, so 2 peripherals
config ZMK_SPLIT_BLE_CENTRAL_PERIPHERALS
    default 2

# 2 peripherals + 5 BT profiles = 7
config BT_MAX_CONN
    default 7

config BT_MAX_PAIRED
    default 7

endif
```

## boards/shields/leeloo/Kconfig.shield
```kconfig
# Copyright (c) 2024 The ZMK Contributors
# SPDX-License-Identifier: MIT

config SHIELD_LEELOO_DONGLE
    def_bool $(shields_list_contains,leeloo_dongle)
```

## boards/shields/leeloo_dongle/Kconfig.defconfig
```kconfig
if SHIELD_LEELOO_DONGLE

config ZMK_KEYBOARD_NAME
  default "Leeloo Dongle"

config ZMK_SPLIT_ROLE_CENTRAL
  default y

config ZMK_SPLIT
  default y

# Set to 2 for left + right halves
config ZMK_SPLIT_BLE_CENTRAL_PERIPHERALS
  default 2

# Set to peripherals (2) + BT profiles (5) + buffer (1)
config BT_MAX_CONN
  default 8

config BT_MAX_PAIRED
  default 8

endif
```

## config/boards/shields/leeloo_dongle/Kconfig.defconfig
```kconfig
if SHIELD_LEELOO_DONGLE

config ZMK_KEYBOARD_NAME
  default "Leeloo Dongle"

config ZMK_SPLIT_ROLE_CENTRAL
  default y

config ZMK_SPLIT
  default y

# Set to 2 for left + right halves
config ZMK_SPLIT_BLE_CENTRAL_PERIPHERALS
  default 2

# Set to peripherals (2) + BT profiles (5) + buffer (1)
config BT_MAX_CONN
  default 8

config BT_MAX_PAIRED
  default 8

# Disable display support since dongle has no display
config ZMK_DISPLAY
  default n

# Disable all display-related features
config ZMK_DISPLAY_STATUS_SCREEN_BUILT_IN
  default n

config ZMK_LV_FONT_DEFAULT_SMALL_MONTSERRAT_26
  default n

config LV_FONT_DEFAULT_MONTSERRAT_26
  default n

config ZMK_WIDGET_LAYER_STATUS
  default n

config ZMK_WIDGET_BATTERY_STATUS
  default n

config ZMK_WIDGET_OUTPUT_STATUS
  default n

config ZMK_WIDGET_WPM_STATUS
  default n

endif
```

## config/boards/shields/leeloo_rev2/Kconfig.defconfig
```kconfig
# Copyright (c) 2023 The ZMK Contributors
# SPDX-License-Identifier: MIT

if SHIELD_LEELOO_REV2_DONGLE_XIAO

config ZMK_KEYBOARD_NAME
    default "Leeloo Dongle"

config ZMK_SPLIT_ROLE_CENTRAL
    default y

config ZMK_SPLIT
    default y

# Set this to the number of peripherals your dongle will have.
# For Leeloo split keyboard, this is 2 (left and right halves)
config ZMK_SPLIT_BLE_CENTRAL_PERIPHERALS
    default 2

# Set this to ZMK_SPLIT_BLE_CENTRAL_PERIPHERALS + your desired number of BT profiles (default is 5)
config BT_MAX_CONN
    default 7

# Set this to the same number as BT_MAX_CONN
config BT_MAX_PAIRED
    default 7

endif
```

## config/boards/shields/leeloo_rev2/Kconfig.shield
```kconfig
# Copyright (c) 2023 The ZMK Contributors
# SPDX-License-Identifier: MIT

config SHIELD_LEELOO_REV2_DONGLE_XIAO
    def_bool $(shields_list_contains,leeloo_rev2_dongle_xiao)
```
